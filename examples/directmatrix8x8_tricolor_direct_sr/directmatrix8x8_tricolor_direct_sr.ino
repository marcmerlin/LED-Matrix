/*************************************************** 
    Tests for library LED-Matrix written for LED matrices that requires
    constant column/row rescans.

    It uses code from the Adafruit I2C LED backpack library designed for
    ----> http://www.adafruit.com/products/881
    ----> http://www.adafruit.com/products/880
    ----> http://www.adafruit.com/products/879
    ----> http://www.adafruit.com/products/878

    Adafruit invests time and resources providing this open source code, 
    please support Adafruit and open-source hardware by purchasing 
    products from Adafruit!

    Original code written by Limor Fried/Ladyada for Adafruit Industries.  
    BSD license, all text above must be included in any redistribution
 ****************************************************/

#include "LED_Matrix.h"

// I shouldn't have to re-include these libs included in LED_Matrix.h
// but I get
// LED_Matrix.h:10:19: fatal error: Wire.h: No such file or directory  #include <Wire.h>
#include <Wire.h>
#include <Adafruit_GFX.h>
#include <TimerOne.h>

#define DEBUG 0

// FIXME, give 595 pinout

#define DATA_PIN DP13
#define CLK_PIN DP19
#define LATCH1_PIN DP18
#define LATCH2_PIN DINV
#define LATCH3_PIN DP0

// A0 -> DP14
GPIO_pin_t line_pins[] = { DP17, DP16, DP15, DP14,  DP9, DP10, DP11, DP12 };

GPIO_pin_t column_pins[] = {  DINV, DINV, DINV, DINV, DINV, DINV, DINV, DINV, 
                              DP8,  DP7,  DP6,  DP5,  DP4,  DP3,  DP2,  DP1,
                              DINV, DINV, DINV, DINV, DINV, DINV, DINV, DINV, };

// LATCH1_PIN -> Latch pin for red, negative to invert the rows
// DINV -> Green is directly connected
// DINV -> no blue
GPIO_pin_t sr_pins[] = { (GPIO_pin_t) -LATCH1_PIN, DINV, 
			 (GPIO_pin_t) -LATCH3_PIN, DATA_PIN, CLK_PIN };

PWMDirectMatrix *matrix;

void setup() {
    // Initializing serial breaks one row (shared pin)
    if (DEBUG) Serial.begin(57600);
    if (DEBUG) while (!Serial);
    if (DEBUG) Serial.println("DirectMatrix Test");

    matrix = new PWMDirectMatrix(8, 8, 3, 1);
    // The ISR frequency is doubled 3 times to create 4 PWM values
    // and will run at x, x*2, x*4, x*16 to simulate 16 levels of
    // intensity without causing 16 interrupts at x, leaving more
    // time for the main loop and causing less intensity loss.
    // 200 flickers a bit for me due to the 1600us 4th scan, 150 removes
    // the flicker for my eyes.
    // For 3 colors, I need 180ns which leaves a spare 12ns for the main
    // loop for the fastest ISR interval.
    matrix->begin(line_pins, column_pins, sr_pins, 180);
}

static const uint8_t PROGMEM
    smile_bmp[] =
    { B00111100,
        B01000010,
        B10100101,
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        B00111100 },
    neutral_bmp[] =
    { B00111100,
        B01000010,
        B10100101,
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        B00111100 },
    frown_bmp[] =
    { B00111100,
        B01000010,
        B10100101,
        B10000001,
        B10011001,
        B10100101,
        B01000010,
        B00111100 };

static const uint16_t PROGMEM
    RGB_bmp[][64] = {
      // grey to white
      {	0x111, 0x222, 0x333, 0x555, 0x777, 0x999, 0xAAA, 0xFFF, 
	0x222, 0x222, 0x333, 0x555, 0x777, 0x999, 0xAAA, 0xFFF, 
	0x333, 0x333, 0x333, 0x555, 0x777, 0x999, 0xAAA, 0xFFF, 
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	0xFFF, 0xFFF, 0xFFF, 0xFFF, 0xFFF, 0xFFF, 0xFFF, 0xFFF, },

      // low red to high red
      {	0x001, 0x002, 0x003, 0x005, 0x007, 0x009, 0x00A, 0x00F, 
	0x002, 0x002, 0x003, 0x005, 0x007, 0x009, 0x00A, 0x00F, 
	0x003, 0x003, 0x003, 0x005, 0x007, 0x009, 0x00A, 0x00F, 
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	0x00F, 0x00F, 0x00F, 0x00F, 0x00F, 0x00F, 0x00F, 0x00F, },

      // low green to high green
      {	0x010, 0x020, 0x030, 0x050, 0x070, 0x090, 0x0A0, 0x0F0, 
	0x020, 0x020, 0x030, 0x050, 0x070, 0x090, 0x0A0, 0x0F0, 
	0x030, 0x030, 0x030, 0x050, 0x070, 0x090, 0x0A0, 0x0F0, 
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	0x0F0, 0x0F0, 0x0F0, 0x0F0, 0x0F0, 0x0F0, 0x0F0, 0x0F0, },

      // low blue to high blue
      {	0x100, 0x200, 0x300, 0x500, 0x700, 0x900, 0xA00, 0xF00, 
	0x200, 0x200, 0x300, 0x500, 0x700, 0x900, 0xA00, 0xF00, 
	0x300, 0x300, 0x300, 0x500, 0x700, 0x900, 0xA00, 0xF00, 
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	0xF00, 0xF00, 0xF00, 0xF00, 0xF00, 0xF00, 0xF00, 0xF00, },

      // blue, blue/red, red, red/green, green, green/blue, blue, white
      // 1 2 3 4 6 8 A F
      {	0x100, 0x200, 0x300, 0x400, 0x600, 0x800, 0xA00, 0xF00, 
	0x101, 0x202, 0x303, 0x404, 0x606, 0x808, 0xA0A, 0xF0F, 
      	0x001, 0x002, 0x003, 0x004, 0x006, 0x008, 0x00A, 0x00F, 
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	0x111, 0x222, 0x333, 0x444, 0x666, 0x888, 0xAAA, 0xFFF, },

      // 1 black, 2R, 2O, 2G, 1B with 4 blue lines rising right
      {	0x000, 0x200, 0x000, 0x400, 0x000, 0x800, 0x000, 0xF00, 
      	0x000, 0x201, 0x002, 0x403, 0x004, 0x805, 0x006, 0xF07, 
	0x008, 0x209, 0x00A, 0x40B, 0x00C, 0x80D, 0x00E, 0xF0F, 
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	0x000, 0x200, 0x000, 0x500, 0x000, 0x800, 0x000, 0xF00, },

      // 4 lines of increasing red and then green
      { 0x000, 0x000, 0x001, 0x001, 0x002, 0x002, 0x003, 0x003, 
	0x004, 0x004, 0x005, 0x005, 0x006, 0x006, 0x007, 0x007, 
	0x008, 0x008, 0x009, 0x009, 0x00A, 0x00A, 0x00B, 0x00B, 
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	0x0C0, 0x0C0, 0x0D0, 0x0D0, 0x0E0, 0x0E0, 0x0F0, 0x0F0, },

      // 4 lines of increasing red and then blue
      { 0x000, 0x000, 0x001, 0x001, 0x002, 0x002, 0x003, 0x003, 
	0x004, 0x004, 0x005, 0x005, 0x006, 0x006, 0x007, 0x007, 
	0x008, 0x008, 0x009, 0x009, 0x00A, 0x00A, 0x00B, 0x00B, 
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	0xC00, 0xC00, 0xD00, 0xD00, 0xE00, 0xE00, 0xF00, 0xF00, },

      // criss cross of green and red with diagonal blue.
      {	0xF00, 0x001, 0x003, 0x005, 0x007, 0x00A, 0x00F, 0x000, 
	0x020, 0xF21, 0x023, 0x025, 0x027, 0x02A, 0x02F, 0x020, 
	0x040, 0x041, 0xF43, 0x045, 0x047, 0x04A, 0x04F, 0x040, 
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	0x000, 0x001, 0x003, 0x005, 0x007, 0x00A, 0x00F, 0xF00, },

      // 2 lines of green, 2 red, 2 orange, 2 green
      { 0x0F0, 0x0F0, 0x0FF, 0x0FF, 0x00F, 0x00F, 0x0F0, 0x0F0, 
	0x0F0, 0x0F0, 0x0FF, 0x0FF, 0x00F, 0x00F, 0x0F0, 0x0F0, 
	0x0F0, 0x0F0, 0x0FF, 0x0FF, 0x00F, 0x00F, 0x0F0, 0x0F0, 
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	0x0F0, 0x0F0, 0x0FF, 0x0FF, 0x00F, 0x00F, 0x0F0, 0x0F0, },

      // multicolor smiley face
      { 0x000, 0x000, 0x00F, 0x00F, 0x00F, 0x00F, 0x000, 0x000, 
	0x000, 0x00F, 0x000, 0x000, 0x000, 0x000, 0x00F, 0x000, 
	0x00F, 0x000, 0xF00, 0x000, 0x000, 0xF00, 0x000, 0x00F, 
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	0x000, 0x000, 0x00F, 0x00F, 0x00F, 0x00F, 0x000, 0x000, },
};

void show_isr() {
    if (DEBUG) Serial.print  (F("ISR runtime: "));
    if (DEBUG) Serial.print  (matrix->ISR_runtime());
    if (DEBUG) Serial.print  (F(" and latency: "));
    if (DEBUG) Serial.println(matrix->ISR_latency());
}

void loop() {
     for (uint8_t i=0; i<=(sizeof(RGB_bmp)/sizeof(RGB_bmp[0])-1); i++)
     {
 	show_isr();
 	matrix->clear();
 	matrix->drawRGBBitmap(0, 0, RGB_bmp[i], 8, 8);
	// writedisplay is a no-op with DirectMatrix.
 	// matrix->writeDisplay();
 	delay(3000);
     }
 
     show_isr();
     matrix->clear();
     matrix->fillRect(0,0, 8,8, LED_WHITE_HIGH);
     matrix->drawRect(1,1, 6,6, LED_WHITE_MEDIUM);
     matrix->drawRect(2,2, 4,4, LED_WHITE_LOW);
     matrix->drawRect(3,3, 2,2, LED_WHITE_VERYLOW);
     // matrix->writeDisplay();
     delay(3000);

     show_isr();
     matrix->clear();
     matrix->drawBitmap(0, 0, smile_bmp, 8, 8, LED_RED_HIGH);
     // matrix->writeDisplay();
     delay(1000);
 
     show_isr();
     matrix->clear();
     matrix->drawBitmap(0, 0, neutral_bmp, 8, 8, LED_GREEN_HIGH);
     // matrix->writeDisplay();
     delay(1000);
 
     show_isr();
     matrix->clear();
     matrix->drawBitmap(0, 0, frown_bmp, 8, 8, LED_BLUE_HIGH);
     // matrix->writeDisplay();
     delay(1000);

     show_isr();
     matrix->clear();
     // Without a matrix like above, a red/green crossing isn't as good.
     matrix->drawLine(0,2, 7,2, LED_RED_VERYLOW);
     matrix->drawLine(0,3, 7,3, LED_RED_LOW);
     matrix->drawLine(0,4, 7,4, LED_RED_MEDIUM);
     matrix->drawLine(0,5, 7,5, LED_RED_HIGH);
     matrix->drawLine(2,0, 2,7, LED_GREEN_VERYLOW);
     matrix->drawLine(3,0, 3,7, LED_GREEN_LOW);
     matrix->drawLine(4,0, 4,7, LED_GREEN_MEDIUM);
     matrix->drawLine(5,0, 5,7, LED_GREEN_HIGH);
     matrix->drawLine(0,0, 7,7, LED_BLUE_HIGH);
     // matrix->writeDisplay();
     delay(2000);

     show_isr();
     matrix->clear();
     matrix->drawRect(0,0, 8,8, LED_BLUE_HIGH);
     matrix->drawRect(1,1, 6,6, LED_GREEN_MEDIUM);
     matrix->fillRect(2,2, 4,4, LED_RED_HIGH);
     // matrix->writeDisplay();
     delay(3000);
 
     show_isr();
     matrix->clear();
     matrix->drawCircle(2,2, 2, LED_RED_MEDIUM);
     matrix->drawCircle(5,5, 2, LED_BLUE_HIGH);
     matrix->drawCircle(1,6, 1, LED_GREEN_LOW);
     matrix->drawCircle(6,1, 1, LED_GREEN_HIGH);
     // matrix->writeDisplay();
     delay(2000);

     matrix->setTextWrap(false);  // we don't wrap text so it scrolls nicely
     matrix->setTextSize(1);
     matrix->setTextColor(LED_GREEN_HIGH);
     matrix->setRotation(3);
     for (int8_t x=7; x>=-36; x--) {
         matrix->clear();
         matrix->setCursor(x,0);
         matrix->print("Hello");
         // matrix->writeDisplay();
 	delay(50);
     }
     delay(100);
     matrix->setRotation(0);
     matrix->setTextColor(LED_ORANGE_HIGH);
     for (int8_t x=7; x>=-36; x--) {
         matrix->clear();
         matrix->setCursor(x,0);
         matrix->print("World");
         // matrix->writeDisplay();
 	delay(50);
     }
    matrix->setRotation(0);
}
